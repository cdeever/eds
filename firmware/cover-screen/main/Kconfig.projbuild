## firmware/cover-screen/main/Kconfig.projbuild
```kconfig
menu "Cover screen"

    config CS_SCREEN_ID
        string "Screen identifier"
        default "cover-screen-01"
        help
            The device's name in the tenant's registry. It is the client id,
            a level in the screen's own topics, and what its commands say
            they are from. Lowercase letters, digits and hyphens.

    config CS_TOPIC_PREFIX
        string "Topic prefix"
        default "eds"
        help
            Root of the topic tree: the tenant's name.

    menu "Panel"

        config CS_PANEL_ROTATE_180
            bool "Turn the picture upside down"
            default n
            help
                The panel is used on its side, and which side is up depends on
                how the board is mounted. The default has the USB socket on
                the right, as the board's own demonstration does.

        config CS_PANEL_BGR
            bool "The panel is wired blue-green-red"
            default y
            help
                Red and blue swapped on the screen means this is wrong.

        config CS_PANEL_INVERT
            bool "Invert colours"
            default n
            help
                A picture that looks like a photographic negative means this
                is wrong. Boards sold with an ST7789 panel want it on.

        config CS_PANEL_GPIO_SCLK
            int "Panel clock GPIO"
            default 14
        config CS_PANEL_GPIO_MOSI
            int "Panel data GPIO"
            default 13
        config CS_PANEL_GPIO_CS
            int "Panel chip select GPIO"
            default 15
        config CS_PANEL_GPIO_DC
            int "Panel data/command GPIO"
            default 2
        config CS_PANEL_GPIO_BACKLIGHT
            int "Backlight GPIO"
            default 21

    endmenu

    menu "Touch"

        config CS_TOUCH_GPIO_SCLK
            int "Touch clock GPIO"
            default 25
            help
                On the ESP32-2432S028R the touch controller has pins of its
                own, apart from the panel's.
        config CS_TOUCH_GPIO_MOSI
            int "Touch data-in GPIO"
            default 32
        config CS_TOUCH_GPIO_MISO
            int "Touch data-out GPIO"
            default 39
        config CS_TOUCH_GPIO_CS
            int "Touch chip select GPIO"
            default 33

        config CS_TOUCH_PRESSURE
            int "Pressure that counts as a touch"
            range 50 4000
            default 400
            help
                Lower is more sensitive. Too low and the screen wakes by
                itself; too high and it wants a fingernail.

        config CS_TOUCH_SWAP_XY
            bool "The controller's axes are the other way round"
            default y
            help
                A finger moved across the screen that moves the touch up and
                down means this is wrong. Each touch is printed on the serial
                console with what the controller read and where that was
                taken to be, which is what these settings are tuned from.

                The defaults here are what the ESP32-2432S028R wants with the
                panel the default way up, found by pressing its buttons. If
                the picture is turned upside down the touch is turned with
                it, and these do not need changing.

        config CS_TOUCH_INVERT_X
            bool "Left and right are swapped"
            default y
        config CS_TOUCH_INVERT_Y
            bool "Up and down are swapped"
            default y

        config CS_TOUCH_X_MIN
            int "Reading at the left edge"
            range 0 4095
            default 240
            help
                The four readings are taken after the axes are swapped and
                before either is turned round: the lower reading of each
                pair, then the higher.
        config CS_TOUCH_X_MAX
            int "Reading at the right edge"
            range 0 4095
            default 3800
        config CS_TOUCH_Y_MIN
            int "Reading at the top edge"
            range 0 4095
            default 200
        config CS_TOUCH_Y_MAX
            int "Reading at the bottom edge"
            range 0 4095
            default 3700

    endmenu

    menu "Network"

        config CS_WIFI_SSID
            string "WiFi SSID"
            default "DVNTM-IOT"
            help
                The screen belongs on the IoT segment (VLAN 30), with the
                stand.

                There is no option for the key, on purpose: it is read from
                the creds partition and from nowhere else, so it cannot end
                up in sdkconfig or the image. `make provision` writes it.

        config CS_MQTT_URI
            string "Broker URI"
            default "mqtts://mqtt.mobile.deevnet.net:8883"
            help
                Normally provisioned rather than set here: `make provision`.

        config CS_MQTT_USERNAME
            string "Broker username"
            default "cover-screen-01"
            help
                The password has no option here, for the same reason the
                WiFi key has none: it is provisioned, never compiled in.

        config CS_MQTT_USE_TLS
            bool "Embed a fallback CA for the broker"
            default n
            help
                Requires main/certs/mqtt_ca.pem. The CA is normally
                provisioned beside the credentials (`make provision`) and this
                is not needed; a provisioned one takes precedence.

    endmenu

endmenu
```

## firmware/ears/main/Kconfig.projbuild
```kconfig
menu "Ears (reSpeaker Lite)"

    config EA_DEVICE_ID
        string "Device identifier"
        default "respeaker-01"
        help
            The device's name in the tenant's registry. It is the client id
            and a level in its own topics. Lowercase letters, digits and
            hyphens.

    config EA_TOPIC_PREFIX
        string "Topic prefix"
        default "eds"
        help
            Root of the topic tree: the tenant's name.

    menu "Sound"

        config EA_I2S_SLAVE
            bool "The XMOS chip drives the I2S clock"
            default y
            help
                The reSpeaker Lite's I2S firmware makes the XMOS chip the
                clock's source and the XIAO its follower. The rate it sends
                is then measured, not chosen, and printed on the console.
                Off makes the XIAO drive the clock at EA_I2S_RATE instead.

        config EA_I2S_RATE
            int "Expected sample rate"
            default 16000
            help
                What the XMOS chip is expected to send, or what the XIAO
                sends when it drives the clock. Seeed publishes the I2S
                firmware at 16 kHz and at 48 kHz; either works, being a
                whole multiple of the 16 kHz scribe takes.

        config EA_I2S_GPIO_BCLK
            int "I2S bit clock GPIO"
            default 8
        config EA_I2S_GPIO_WS
            int "I2S word select GPIO"
            default 7
        config EA_I2S_GPIO_DIN
            int "I2S data-in GPIO"
            default 44
            help
                The pins are Seeed's examples' for the reSpeaker Lite. A
                console that says no clock arrives means these are wrong.

        config EA_VOICE_CHANNEL
            int "Channel with the voice"
            range 0 1
            default 0
            help
                0 is left, 1 is right. The XMOS chip sends its cleaned-up
                voice on one and something else on the other; the console
                prints the level of both, and the one that rises when
                someone speaks is this.

    endmenu

    menu "Wake word"

        config EA_WAKE_WORD
            string "What it answers to"
            default "Hey Jarvis"
            help
                For the console and the log. The model is
                main/models/hey_jarvis.tflite, and the settings below are
                its manifest's (main/models/hey_jarvis.json).

        config EA_WAKE_CUTOFF
            int "Probability that counts, of 255"
            range 1 255
            default 247
            help
                The manifest's probability_cutoff, 0.97, as ESPHome holds it.
                Lower wakes more readily, and more often for nothing.

        config EA_WAKE_WINDOW
            int "Answers averaged"
            range 1 20
            default 5
            help
                The manifest's sliding_window_size.

        config EA_WAKE_STEP_MS
            int "Feature step, ms"
            default 10
            help
                The manifest's feature_step_size.

        config EA_WAKE_ARENA
            int "Model arena, bytes"
            default 22860
            help
                The manifest's tensor_arena_size. Twice this is allocated, as
                ESPHome is prepared to; the console says how much is used.

    endmenu

    menu "Button and light"

        config EA_BUTTON_GPIO
            int "Talk button GPIO"
            default 0
            help
                Held, what is said is sent. The default is the XIAO's own
                BOOT button, which reads low when pressed.

        config EA_LED_GPIO
            int "Light GPIO"
            default 21
            help
                The XIAO's own yellow LED, which is lit by pulling it low.

    endmenu

    menu "Network"

        config EA_WIFI_SSID
            string "WiFi SSID"
            default "DVNTM-IOT"
            help
                The IoT segment (VLAN 30), with the other devices. There is
                no option for the key, on purpose: `make provision` writes it.

        config EA_MQTT_URI
            string "Broker URI"
            default "mqtts://mqtt.mobile.deevnet.net:8883"

        config EA_MQTT_USERNAME
            string "Broker username"
            default "respeaker-01"

        config EA_MQTT_USE_TLS
            bool "Embed a fallback CA for the broker"
            default n
            help
                Requires main/certs/mqtt_ca.pem. The CA is normally
                provisioned beside the credentials.

    endmenu

endmenu
```

## firmware/lp-stand/main/Kconfig.projbuild
```kconfig
menu "LP jacket stand"

    config LP_STAND_ID
        string "Stand identifier"
        default "lp-stand-01"
        help
            Appears in the MQTT topics and as the client id. Must match the
            stand lightd publishes to: eds/lightstand/<id>/scene.

    config LP_TOPIC_PREFIX
        string "Topic prefix"
        default "eds"
        help
            Root of the topic tree. Must match lightd's LIGHTD_TOPIC_PREFIX.

    menu "Strip"

        config LP_LED_COUNT
            int "Number of LEDs"
            range 1 300
            default 60

        config LP_LED_GPIO
            int "Data GPIO"
            range 0 48
            default 18
            help
                Data line for the WS2812/SK6812 strip. Pick a pin that is not
                strapped at boot, or the strip will flicker during reset.

    endmenu

    menu "Network"

        config LP_WIFI_SSID
            string "WiFi SSID"
            default "DVNTM-IOT"
            help
                The stand belongs on the IoT segment (VLAN 30), where the
                segmentation model puts custom-firmware embedded devices.

                There is no option for the key, on purpose: it is read from
                the creds partition and from nowhere else, so it cannot end
                up in sdkconfig or the image. `make provision` writes it.

        config LP_MQTT_URI
            string "Broker URI"
            default "mqtts://mqtt.mobile.deevnet.net:8883"
            help
                The substrate's broker is TLS only: nothing listens on 1883.
                mqtt:// is for bring-up against a local broker. `mqtt` is a
                service name on IoT Backend (VLAN 35), so the host behind it
                can move without reflashing every stand.

                Normally provisioned rather than set here: `make provision`.

        config LP_MQTT_USERNAME
            string "Broker username"
            default "lp-stand-01"
            help
                The password has no option here, for the same reason the
                WiFi key has none: it is provisioned, never compiled in.

        config LP_MQTT_USE_TLS
            bool "Embed a fallback CA for the broker"
            default n
            help
                Requires main/certs/mqtt_ca.pem. The CA is normally
                provisioned beside the credentials (`make provision`) and this
                is not needed; a provisioned one takes precedence.

    endmenu

endmenu
```

## firmware/power-beacon/main/Kconfig.projbuild
```kconfig
menu "Power beacon"

    config PB_BEACON_ID
        string "Beacon identifier"
        default "turntable-power-01"
        help
            The device's name in the tenant's registry. It is the client id
            and a level in the beacon's own topics. Lowercase letters, digits
            and hyphens.

            The name is the only place that says what the beacon shares a
            switch with. The firmware is the same for any of them.

    config PB_TOPIC_PREFIX
        string "Topic prefix"
        default "eds"
        help
            Root of the topic tree: the tenant's name.

    menu "Network"

        config PB_WIFI_SSID
            string "WiFi SSID"
            default "DVNTM-IOT"
            help
                The beacon belongs on the IoT segment (VLAN 30), with the
                stand.

                There is no option for the key, on purpose: it is read from
                the creds partition and from nowhere else, so it cannot end
                up in sdkconfig or the image. `make provision` writes it.

        config PB_MQTT_URI
            string "Broker URI"
            default "mqtts://mqtt.mobile.deevnet.net:8883"
            help
                Normally provisioned rather than set here: `make provision`.

        config PB_MQTT_USERNAME
            string "Broker username"
            default "turntable-power-01"
            help
                The password has no option here, for the same reason the
                WiFi key has none: it is provisioned, never compiled in.

        config PB_MQTT_USE_TLS
            bool "Embed a fallback CA for the broker"
            default n
            help
                Requires main/certs/mqtt_ca.pem. The CA is normally
                provisioned beside the credentials (`make provision`) and this
                is not needed; a provisioned one takes precedence.

    endmenu

endmenu
```
